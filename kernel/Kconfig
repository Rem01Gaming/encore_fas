## kernel/Kconfig
```kconfig
config ENCORE_FAS
	tristate "Encore Tweaks FAS kernel module"
	depends on ARM64 && UPROBES && ANDROID
	default n
	help
	  Frame aware scheduling driver for Encore Tweaks (/dev/encore_fas).
	  The module puts a uprobe on Surface::queueBuffer of a game and
	  reports late frames, a low frame rate, and pauses to a daemon.

	  Say N unless you build a daemon that uses this module.
```
